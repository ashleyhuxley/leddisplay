char widths[] = {2, 1, 3, 5, 5, 5, 5, 2, 3, 3, 5, 5, 2,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 3, 0  };

char font[][5] = {
  {0,0,0,0,0},
  {125,0,0,0,0},
  {96,0,96,0,0},
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  {0,0,0,0,0}
};

char msg[] = "This Is Fen";

char buffer[7][15];
int pos = -4;

// Plots a single pixel onto the buffer
void Plot(int col, int row, bool isOn)
{
  if ((col < 0) || (col > 119) || (row < 0) || (row > 6))
  {
    return;
  }

  int zone = col / 8;
  int colBitIndex = col % 8;

  char colBit = 1 << colBitIndex;
  if (isOn)
  {
    buffer[row][zone] = buffer[row][zone] | colBit;
  }
  else
  {
    buffer[row][zone] = buffer[row][zone] & (~colBit);
  }
}

// Takes the current message and renders it to the buffer
void render()
{
  int offset = 0;

  // For each character
  for (int i = 0; i < sizeof(msg) - 1; i++)
  {
    // Get index of font glyph
    int alphabetIndex = msg[i] - ' ';
    if (alphabetIndex < 0)
    {
      alphabetIndex = 0;
    }

    // For each pixel in the width
    for (int j = 0; j < widths[alphabetIndex]; j++)
    {
      // Get the byte that corresponds to the column
      int b = font[alphabetIndex][j];
      // For each row
      for (int row = 0; row < 7; row++)
      {
        // Plot the pixel on the bitmap
        int ck = round(pow(2, 6 - row));
        bool isOn = b >= ck;
        Plot(pos + offset, row, isOn);

        if (isOn) { Serial.print("X"); } else { Serial.print(" "); };

        if (isOn)
        {
          b -= ck;
        }
      }

      // Empty space between letters
      offset += 1;
      for (int erow = 0; erow < 7; erow++)
      {
        Plot(pos + offset, erow, false);
      }

      offset += 1;
      Serial.println();
    }
  }
}


void setup() {
  Serial.begin(9600);
  delay(1000);
  render();
}

void loop() {
  //Serial.println();
  delay(1000);
}
